## sdkconfig.defaults
```kconfig
# Target
CONFIG_IDF_TARGET="esp32s3"

# Board Configuration
CONFIG_BOARD_TYPE_FELIXNGUYEN_1_83_1MIC=y

# Language Configuration
CONFIG_LANGUAGE_VI_VN=y

# ESP32-S3 Configuration
CONFIG_ESPTOOLPY_FLASHSIZE_16MB=y
CONFIG_ESPTOOLPY_FLASHMODE_QIO=y
CONFIG_ESPTOOLPY_FLASHFREQ_80M=y

# Partition Table - Use custom partition with 6MB app slots
CONFIG_PARTITION_TABLE_CUSTOM=y
CONFIG_PARTITION_TABLE_CUSTOM_FILENAME="partitions.csv"
CONFIG_PARTITION_TABLE_FILENAME="partitions.csv"

# LVGL Configuration
CONFIG_LV_FONT_FMT_TXT_LARGE=y
CONFIG_LV_USE_IMGFONT=y

# C++ Configuration - Enable exceptions for IoT thing manager
CONFIG_COMPILER_CXX_EXCEPTIONS=y
CONFIG_COMPILER_CXX_EXCEPTIONS_EMG_POOL_SIZE=1024

# WiFi Configuration - Disable power save to fix LWIP mbox issue
CONFIG_ESP_WIFI_STA_DISCONNECTED_PM_ENABLE=n

# WiFi buffer optimization - Reduce static RX buffers to free internal SRAM
# Default 10 buffers * 1600 bytes = 16KB internal RAM
# Reduce to 4 saves 9.6KB, enough for pthread stacks
CONFIG_ESP_WIFI_STATIC_RX_BUFFER_NUM=4
CONFIG_ESP_WIFI_DYNAMIC_TX_BUFFER_NUM=16
CONFIG_ESP_WIFI_RX_BA_WIN=6

# LWIP Configuration - Increase mbox size to fix tcpip_inpkt crash
CONFIG_LWIP_TCPIP_RECVMBOX_SIZE=64
CONFIG_LWIP_TCP_RECVMBOX_SIZE=12
CONFIG_LWIP_UDP_RECVMBOX_SIZE=12

# FreeRTOS Configuration - Main task stack (8KB sufficient after init)
CONFIG_ESP_MAIN_TASK_STACK_SIZE=8192

# Wake Word Configuration - Hi Lili
CONFIG_SR_WN_WN9_NIHAOXIAOZHI_TTS=n
CONFIG_SR_WN_WN9_HILILI_TTS=y
```

## sdkconfig.defaults.esp32s3
```kconfig
CONFIG_ESPTOOLPY_FLASHSIZE_16MB=y
CONFIG_ESPTOOLPY_FLASHMODE_QIO=y

CONFIG_ESP_DEFAULT_CPU_FREQ_MHZ_240=y

CONFIG_SPIRAM=y
CONFIG_SPIRAM_MODE_OCT=y
CONFIG_SPIRAM_SPEED_80M=y
CONFIG_SPIRAM_MALLOC_ALWAYSINTERNAL=2048
CONFIG_SPIRAM_MALLOC_RESERVE_INTERNAL=49152
CONFIG_SPIRAM_MEMTEST=n
CONFIG_SPIRAM_ALLOW_STACK_EXTERNAL_MEMORY=y
CONFIG_SPIRAM_TRY_ALLOCATE_WIFI_LWIP=y
CONFIG_MBEDTLS_EXTERNAL_MEM_ALLOC=y

CONFIG_ESP32S3_INSTRUCTION_CACHE_32KB=y
CONFIG_ESP32S3_DATA_CACHE_64KB=y
CONFIG_ESP32S3_DATA_CACHE_LINE_64B=y

# Wake word configured in sdkconfig.defaults
# CONFIG_SR_WN_WN9_NIHAOXIAOZHI_TTS=y

CONFIG_ESP_SYSTEM_EVENT_TASK_STACK_SIZE=4096
```
